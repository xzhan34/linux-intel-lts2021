## drivers/gpu/drm/i915/Kconfig.chicken
```kconfig
config DRM_I915_CHICKEN_ASYNC_GET_PAGES
	bool
	default y
	help
	  Acquire and clear the backing store (chunks of local memory or pages
	  of system memory) in a background thread, returning to userspace
	  without blocking. Access or execution of the object is deferred
	  instead.

config DRM_I915_CHICKEN_CLEAR_ON_CREATE
	bool
	default n
	help
	  Queue the clear of all objects at the point of creation (GEM_CREATE
	  ioctl), ahead of first use.

config DRM_I915_CHICKEN_CLEAR_ON_FREE
	bool
	default y
	help
	  Clear pages on release, ahead of reuse.

config DRM_I915_CHICKEN_CLEAR_ON_IDLE
	bool
	default y
	help
	  Clear pages on idling, and upon boot.
```

## drivers/gpu/drm/i915/fabric/Kconfig
```kconfig
# SPDX-License-Identifier: GPL-2.0-only
config DRM_I915_INTEL_FABRIC
	tristate "Intel Fabric Connectivity driver support"
	depends on 64BIT
	depends on NET
	select LIBCRC32C
	default m
	help
	  This kernel driver provides support for the Intel glueless
	  fabric adapter. The Intel fabric adapter allows GPUs to share
	  device memory space in a device specific address space.

config IAF_DEBUG_ENABLE
	bool "Enable Intel Accelerator Fabric debug configurations"
	depends on DRM_I915_INTEL_FABRIC
	default n
	help
	  Support Intel Accelerator Fabric debug Kconfig options

config IAF_DEBUG_STARTUP
	bool "Enable Intel Accelerator Fabric debug startup mode"
	depends on IAF_DEBUG_ENABLE
	default y
	help
	  DO NOT UPSTREAM:
	  Allow startup_mode parameter to boot devices into debug modes
```

## drivers/media/pci/intel/hkrcam/Kconfig
```kconfig
# SPDX-License-Identifier: GPL-2.0-only
config VIDEO_HKR
	tristate "Intel hkr driver"
	depends on VIDEO_V4L2 && PCI
	depends on ACPI || COMPILE_TEST
	depends on MEDIA_SUPPORT
	depends on X86
	select MEDIA_CONTROLLER
	select VIDEOBUF2_DMA_CONTIG
	select VIDEO_V4L2_SUBDEV_API
	select VIDEOBUF2_DMA_SG

	help
	  This is the Intel IPU3 CIO2 CSI-2 receiver unit, found in Intel
```

## drivers/media/platform/intel/Kconfig
```kconfig
config INTEL_IPU6_ADLRVP_PDATA
	bool "Enable built in platform data for ADL RVP"
	depends on MEDIA_CAMERA_SUPPORT
	help
	 Pre-ACPI system platform data is compiled inside kernel

	 This platform data is useful for software development before
	 the SOC system not ready.
```

## drivers/vfio/pci/i915/Kconfig
```kconfig
# SPDX-License-Identifier: GPL-2.0-only

config I915_VFIO_PCI
	tristate "VFIO vendor-specific PCI driver for Intel Graphics"
	depends on DRM_I915
	help
	  This option enables vendor-specific VFIO driver for Intel Graphics.
	  In addition to generic VFIO PCI functionality, it implements VFIO
	  migration uAPI (v1) allowing userspace to enable migration for
	  Intel Graphics SR-IOV Virtual Functions.
```
